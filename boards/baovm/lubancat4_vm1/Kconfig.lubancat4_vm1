## boards/baovm/lubancat4_vm1/Kconfig.lubancat4_vm1
```kconfig
#  SPDX-License-Identifier: Apache-2.0
#  Copyright 2026 haonan yu <yowaii47@gmail.com>

config BOARD_LUBANCAT4_VM1
    select SOC_RK3588
```

## boards/baovm/lubancat4_vm1/board.yml
```yaml
board:
  name: lubancat4_vm1
  full_name: Baovm Lubancat4 VM1 based on Rockchip RK3588S
  vendor: baovm
  socs:
  - name: rk3588
```

## boards/baovm/lubancat4_vm1/lubancat4_vm1_defconfig
```kconfig
# SPDX-License-Identifier: Apache-2.0
# Copyright The Zephyr Project Contributors

# Platform Configuration
CONFIG_ARM_ARCH_TIMER=y
CONFIG_SYS_CLOCK_HW_CYCLES_PER_SEC=24000000
CONFIG_CLOCK_CONTROL=y
CONFIG_RESET=y
CONFIG_ARM64_VA_BITS_40=y
CONFIG_ARM64_PA_BITS_40=y

# Serial Drivers
CONFIG_SERIAL=y
CONFIG_UART_NS16550=y
CONFIG_UART_INTERRUPT_DRIVEN=y
CONFIG_GPIO=y
CONFIG_SPI=y

# CAN Drivers
CONFIG_CAN=y
CONFIG_CAN_ROCKCHIP_CANFD=y

# Enable console
CONFIG_CONSOLE=y
CONFIG_UART_CONSOLE=y

# ARMv8 NS world with cache management
CONFIG_ARMV8_A_NS=y
CONFIG_CACHE_MANAGEMENT=y
```

## drivers/can/Kconfig.rockchip
```kconfig
# Rockchip CAN controller configuration

# SPDX-FileCopyrightText: Copyright The Zephyr Project Contributors
# SPDX-License-Identifier: Apache-2.0

config CAN_ROCKCHIP_CANFD
	bool "Rockchip RK3588 CAN-FD controller"
	default y
	depends on DT_HAS_ROCKCHIP_RK3588_CANFD_ENABLED
	help
	  Enable the Rockchip RK3588 CAN-FD controller driver. Only classic CAN
	  is supported by this driver.

config CAN_ROCKCHIP_CANFD_MAX_FILTERS
	int "Maximum number of concurrent RX filters"
	depends on CAN_ROCKCHIP_CANFD
	default 16
	range 1 32
	help
	  The controller does not provide a general purpose hardware filter
	  list, so received frames are matched against a software filter list.
	  This option sets the maximum number of concurrent RX filters.
```

## drivers/gpio/Kconfig.rockchip
```kconfig
# Rockchip GPIO configuration options

# SPDX-License-Identifier: Apache-2.0

config GPIO_ROCKCHIP
	bool "Rockchip RK3588 GPIO driver"
	default y
	depends on DT_HAS_ROCKCHIP_RK3588_GPIO_ENABLED
	help
	  Enable support for the Rockchip GPIO controller used on RK3588.
```

## drivers/pinctrl/Kconfig.rockchip
```kconfig
# SPDX-License-Identifier: Apache-2.0

config PINCTRL_ROCKCHIP
	bool "Rockchip RK3588 pinctrl driver"
	depends on DT_HAS_ROCKCHIP_RK3588_PINCTRL_ENABLED
	help
	  Enable support for the Rockchip RK3588 pin control driver.
```

## dts/bindings/can/rockchip,rk-can.yaml
```yaml
# SPDX-License-Identifier: Apache-2.0

description: Rockchip CAN controller

compatible: "rockchip,rk-can"

include: [can-controller.yaml]

properties:
  reg:
    required: true

  interrupts:
    required: true

  clock-frequency:
    type: int
    default: 80000000
    description: |
      Input clock frequency in Hz used by CAN bit timing calculations.

  max-filters:
    type: int
    description: |
      Maximum number of concurrently active RX filters supported by this
      controller instance.
```

## dts/bindings/can/rockchip,rk3588-canfd.yaml
```yaml
# SPDX-FileCopyrightText: Copyright The Zephyr Project Contributors
# SPDX-License-Identifier: Apache-2.0

title: Rockchip RK3588 CAN-FD controller

description: |
  Rockchip RK3588 CAN-FD controller. The controller supports classic CAN and
  CAN FD; this binding describes the controller and the driver currently
  exposes classic CAN only.

compatible: "rockchip,rk3588-canfd"

include: [can-controller.yaml, reset-device.yaml]

properties:
  reg:
    required: true

  interrupts:
    required: true

  clocks:
    required: true
    description: |
      CAN baud clock (first) and APB pclk (second).

  clock-names:
    required: true
    description: |
      Must be "baud" for the CAN baud clock and "pclk" for the APB pclk.

  resets:
    required: true
    description: |
      Controller reset (first) and APB reset (second).

  reset-names:
    required: true
    description: |
      Must be "core" for the controller reset and "apb" for the APB reset.
```

## dts/bindings/gpio/rockchip,rk3588-gpio.yaml
```yaml
# SPDX-License-Identifier: Apache-2.0

description: Rockchip RK3588 GPIO controller

compatible: "rockchip,rk3588-gpio"

include: [gpio-controller.yaml, base.yaml]

properties:
  reg:
    required: true

  interrupts:
    required: true

  "#gpio-cells":
    const: 2

  rockchip,bank:
    required: true
    type: int
    description: |
      GPIO bank index used by pinctrl pinmux encoding.

gpio-cells:
  - pin
  - flags
```

## dts/bindings/pinctrl/rockchip,rk3588-pinctrl.yaml
```yaml
description: Rockchip RK3588 pin controller

compatible: "rockchip,rk3588-pinctrl"

include: base.yaml

properties:
  rockchip,grf:
    required: true
    type: phandle
    description: |
      phandle to the GRF (General Register Files) node

child-binding:
  description: Pin configuration state nodes.
  child-binding:
    description: Pin configuration group.
    include:
      - name: pincfg-node.yaml
        property-allowlist:
          - bias-pull-up
          - bias-pull-down
          - input-enable
    properties:
      pinmux:
        required: true
        type: array
        description: |
          pinmux configuration
      drive-strength:
        type: int
        enum: [0, 4, 2, 6, 1, 5]
        description: |
          drive strength, corresponding drive strengths [100, 66, 50, 33, 25, 20] in ohms
        
```

## dts/bindings/spi/rockchip,rk3588-spi.yaml
```yaml
# SPDX-License-Identifier: Apache-2.0

description: Rockchip RK3588 SPI controller

compatible: "rockchip,rk3588-spi"

include: [spi-controller.yaml, pinctrl-device.yaml]

properties:
  reg:
    required: true

  interrupts:
    required: true

  clock-frequency:
    type: int
    description: Input clock frequency for the SPI controller in Hz.

  num-cs:
    type: int
    default: 2
    description: Number of hardware chip select outputs supported by the controller.
```

## tests/drivers/can/rockchip/testcase.yaml
```yaml
common:
  tags: drivers can rockchip
  timeout: 60

tests:
  driver.can.rockchip.init:
    filter: dt_compat_enabled("rockchip,rk-can")
    platform_skip:
      - nsim
      - qemu_riscv32_virt
    extra_configs:
      - CONFIG_CAN=y
      - CONFIG_CAN_ROCKCHIP=y
      - CONFIG_CAN_LOG_LEVEL_DBG=y

  driver.can.rockchip.mode_timing:
    filter: dt_compat_enabled("rockchip,rk-can")
    platform_skip:
      - nsim
      - qemu_riscv32_virt
    extra_configs:
      - CONFIG_CAN=y
      - CONFIG_CAN_ROCKCHIP=y
      - CONFIG_CAN_LOG_LEVEL_DBG=y

  driver.can.rockchip.tx_rx:
    filter: dt_compat_enabled("rockchip,rk-can")
    platform_skip:
      - nsim
      - qemu_riscv32_virt
    extra_configs:
      - CONFIG_CAN=y
      - CONFIG_CAN_ROCKCHIP=y
      - CONFIG_CAN_LOG_LEVEL_DBG=y

  driver.can.rockchip.filtering:
    filter: dt_compat_enabled("rockchip,rk-can")
    platform_skip:
      - nsim
      - qemu_riscv32_virt
    extra_configs:
      - CONFIG_CAN=y
      - CONFIG_CAN_ROCKCHIP=y
      - CONFIG_CAN_ROCKCHIP_MAX_FILTERS=8
      - CONFIG_CAN_LOG_LEVEL_DBG=y

  driver.can.rockchip.interrupt_state:
    filter: dt_compat_enabled("rockchip,rk-can")
    platform_skip:
      - nsim
      - qemu_riscv32_virt
    extra_configs:
      - CONFIG_CAN=y
      - CONFIG_CAN_ROCKCHIP=y
      - CONFIG_CAN_MANUAL_RECOVERY_MODE=y
      - CONFIG_CAN_LOG_LEVEL_DBG=y
```
