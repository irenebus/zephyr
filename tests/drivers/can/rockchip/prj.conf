## CMakeLists.txt
```
# SPDX-License-Identifier: Apache-2.0

cmake_minimum_required(VERSION 3.20.0)
find_package(Zephyr REQUIRED HINTS $ENV{ZEPHYR_BASE})
project(rockchip_can_testing)

target_sources(app PRIVATE src/common.c)
target_sources(app PRIVATE src/init_test.c)
target_sources(app PRIVATE src/mode_timing_test.c)
target_sources(app PRIVATE src/tx_rx_test.c)
target_sources(app PRIVATE src/filtering_test.c)
target_sources(app PRIVATE src/interrupt_state_test.c)

# Include paths
target_include_directories(app PRIVATE src)
```

## prj.conf
```kconfig
# SPDX-License-Identifier: Apache-2.0

# CAN Driver Configuration
CONFIG_CAN=y
CONFIG_CAN_LOG_LEVEL_DBG=y

# Rockchip CAN Configuration
CONFIG_CAN_ROCKCHIP=y
CONFIG_CAN_ROCKCHIP_MAX_FILTERS=8

# Optional features
CONFIG_CAN_MANUAL_RECOVERY_MODE=y
CONFIG_CAN_FD_MODE=n

# Zephyr Test Framework
CONFIG_ZTEST=y

# Kernel Configuration
CONFIG_KERNEL_MEM_POOL=y
CONFIG_HEAP_MEM_POOL_SIZE=4096
CONFIG_THREAD_STACK_INFO=y

# Logging
CONFIG_LOG=y
CONFIG_LOG_BACKEND_UART=y
CONFIG_UART_CONSOLE=y

CONFIG_PINCTRL=n
```

## app.overlay
```dts
/ {
    chosen {
        zephyr,canbus = &can2; 
    };
};

&can2 {
    status = "okay";
};
```

## src/common.c
```c
/*
 * SPDX-License-Identifier: Apache-2.0
 *
 * Rockchip CAN Driver Tests - Common Implementation
 */

#include <zephyr/drivers/can.h>
#include <zephyr/kernel.h>
#include <zephyr/ztest.h>

#include "common.h"

/* Global CAN device pointer */
ZTEST_DMEM const struct device *can_dev = DEVICE_DT_GET(DT_CHOSEN(zephyr_canbus));

/* Semaphores for callback synchronization */
ZTEST_DMEM struct k_sem rx_callback_sem;
ZTEST_DMEM struct k_sem tx_callback_sem;

/* Last received frame and filter info */
ZTEST_DMEM struct can_frame last_rx_frame = {0};
ZTEST_DMEM int last_rx_filter_id = -1;

/* Standard frame test data */
const struct can_frame test_std_frame_1 = {
	.flags = 0,
	.id = TEST_CAN_STD_ID_1,
	.dlc = 8,
	.data = {1, 2, 3, 4, 5, 6, 7, 8},
};

const struct can_frame test_std_frame_2 = {
	.flags = 0,
	.id = TEST_CAN_STD_ID_2,
	.dlc = 8,
	.data = {8, 7, 6, 5, 4, 3, 2, 1},
};

/* Extended frame test data */
const struct can_frame test_ext_frame_1 = {
	.flags = CAN_FRAME_IDE,
	.id = TEST_CAN_EXT_ID_1,
	.dlc = 8,
	.data = {10, 11, 12, 13, 14, 15, 16, 17},
};

const struct can_frame test_ext_frame_2 = {
	.flags = CAN_FRAME_IDE,
	.id = TEST_CAN_EXT_ID_2,
	.dlc = 8,
	.data = {17, 16, 15, 14, 13, 12, 11, 10},
};

/* RTR frame test data */
const struct can_frame test_std_rtr_frame_1 = {
	.flags = CAN_FRAME_RTR,
	.id = TEST_CAN_STD_ID_1,
	.dlc = 0,
	.data = {0},
};

const struct can_frame test_ext_rtr_frame_1 = {
	.flags = CAN_FRAME_IDE | CAN_FRAME_RTR,
	.id = TEST_CAN_EXT_ID_1,
	.dlc = 0,
	.data = {0},
};

/**
 * @brief Test setup - initialize semaphores and prepare device
 */
void test_setup(void)
{
	k_sem_init(&rx_callback_sem, 0, 10);
	k_sem_init(&tx_callback_sem, 0, 10);
	
	if (!device_is_ready(can_dev)) {
		ztest_test_skip();
	}
}

/**
 * @brief Test teardown - stop device and cleanup
 */
void test_teardown(void)
{
	int ret = can_stop(can_dev);
	zassert_true(ret == 0 || ret == -EALREADY, "Failed to stop CAN device");
}
```

## src/common.h
```c
/*
 * SPDX-License-Identifier: Apache-2.0
 *
 * Rockchip CAN Driver Tests - Common Definitions
 */

#ifndef ZEPHYR_TESTS_DRIVERS_CAN_ROCKCHIP_SRC_COMMON_H_
#define ZEPHYR_TESTS_DRIVERS_CAN_ROCKCHIP_SRC_COMMON_H_

#include <zephyr/drivers/can.h>
#include <zephyr/kernel.h>
#include <zephyr/ztest.h>

/* Test CAN IDs */
#define TEST_CAN_STD_ID_1 0x123
#define TEST_CAN_STD_ID_2 0x456
#define TEST_CAN_EXT_ID_1 0x12345678
#define TEST_CAN_EXT_ID_2 0x87654321

/* Test frames */
extern const struct can_frame test_std_frame_1;
extern const struct can_frame test_std_frame_2;
extern const struct can_frame test_ext_frame_1;
extern const struct can_frame test_ext_frame_2;
extern const struct can_frame test_std_rtr_frame_1;
extern const struct can_frame test_ext_rtr_frame_1;

/* Global variables */
extern const struct device *can_dev;
extern struct k_sem rx_callback_sem;
extern struct k_sem tx_callback_sem;
extern struct can_frame last_rx_frame;
extern int last_rx_filter_id;

/* Test utilities */
void test_setup(void);
void test_teardown(void);

#endif /* ZEPHYR_TESTS_DRIVERS_CAN_ROCKCHIP_SRC_COMMON_H_ */
```

## src/filtering_test.c
```c
/*
 * SPDX-License-Identifier: Apache-2.0
 *
 * Rockchip CAN Driver Tests - RX Filter Tests
 */

#include <zephyr/drivers/can.h>
#include <zephyr/kernel.h>
#include <zephyr/ztest.h>

#include "common.h"

static int filter_rx_count = 0;

/**
 * @brief Generic RX callback for filter testing
 */
static void filter_rx_callback(const struct device *dev, struct can_frame *frame,
			       void *user_data)
{
	zassert_equal(dev, can_dev, "Device mismatch in RX callback");
	zassert_not_null(frame, "Frame is NULL in RX callback");
	
	filter_rx_count++;
	last_rx_frame = *frame;
	k_sem_give(&rx_callback_sem);
}

/**
 * @brief Test adding a basic RX filter
 */
ZTEST(rockchip_can_filtering, test_add_rx_filter_basic)
{
	int filter_id;
	struct can_filter filter = {
		.flags = 0,
		.id = TEST_CAN_STD_ID_1,
		.mask = CAN_STD_ID_MASK,
	};

	filter_id = can_add_rx_filter(can_dev, filter_rx_callback, NULL, &filter);
	zassert_true(filter_id >= 0, "Failed to add RX filter");

	can_remove_rx_filter(can_dev, filter_id);
}

/**
 * @brief Test adding multiple RX filters
 */
ZTEST(rockchip_can_filtering, test_add_multiple_filters)
{
	int filter_id1, filter_id2, filter_id3;
	struct can_filter filter = {0};

	filter.id = TEST_CAN_STD_ID_1;
	filter.mask = CAN_STD_ID_MASK;
	filter_id1 = can_add_rx_filter(can_dev, filter_rx_callback, NULL, &filter);
	zassert_true(filter_id1 >= 0, "Failed to add first filter");

	filter.id = TEST_CAN_STD_ID_2;
	filter_id2 = can_add_rx_filter(can_dev, filter_rx_callback, NULL, &filter);
	zassert_true(filter_id2 >= 0, "Failed to add second filter");

	filter.id = TEST_CAN_EXT_ID_1;
	filter.flags = CAN_FILTER_IDE;
	filter_id3 = can_add_rx_filter(can_dev, filter_rx_callback, NULL, &filter);
	zassert_true(filter_id3 >= 0, "Failed to add third filter");

	can_remove_rx_filter(can_dev, filter_id1);
	can_remove_rx_filter(can_dev, filter_id2);
	can_remove_rx_filter(can_dev, filter_id3);
}

/**
 * @brief Test adding filter with NULL callback fails
 */
ZTEST(rockchip_can_filtering, test_add_filter_null_callback)
{
	int filter_id;
	struct can_filter filter = {
		.flags = 0,
		.id = TEST_CAN_STD_ID_1,
		.mask = CAN_STD_ID_MASK,
	};

	filter_id = can_add_rx_filter(can_dev, NULL, NULL, &filter);
	zassert_equal(filter_id, -EINVAL, "Should reject NULL callback");
}

/**
 * @brief Test adding filter with NULL filter pointer fails
 */
ZTEST(rockchip_can_filtering, test_add_filter_null_filter)
{
	int filter_id;

	filter_id = can_add_rx_filter(can_dev, filter_rx_callback, NULL, NULL);
	zassert_equal(filter_id, -EINVAL, "Should reject NULL filter pointer");
}

/**
 * @brief Test removing a filter
 */
ZTEST(rockchip_can_filtering, test_remove_filter)
{
	int filter_id;
	struct can_filter filter = {
		.flags = 0,
		.id = TEST_CAN_STD_ID_1,
		.mask = CAN_STD_ID_MASK,
	};

	filter_id = can_add_rx_filter(can_dev, filter_rx_callback, NULL, &filter);
	zassert_true(filter_id >= 0, "Failed to add filter");

	/* Removing should not return any error  */
	can_remove_rx_filter(can_dev, filter_id);
}

/**
 * @brief Test removing with invalid filter ID
 */
ZTEST(rockchip_can_filtering, test_remove_filter_invalid_id)
{
	/* Should not crash or return error for invalid IDs */
	can_remove_rx_filter(can_dev, -1);
	can_remove_rx_filter(can_dev, 999);
}

/**
 * @brief Test standard frame filter
 */
ZTEST(rockchip_can_filtering, test_filter_standard_frame)
{
	int filter_id;
	struct can_filter filter = {
		.flags = 0,
		.id = TEST_CAN_STD_ID_1,
		.mask = CAN_STD_ID_MASK,
	};

	filter_id = can_add_rx_filter(can_dev, filter_rx_callback, NULL, &filter);
	zassert_true(filter_id >= 0, "Failed to add filter");

	can_remove_rx_filter(can_dev, filter_id);
}

/**
 * @brief Test extended frame filter
 */
ZTEST(rockchip_can_filtering, test_filter_extended_frame)
{
	int filter_id;
	struct can_filter filter = {
		.flags = CAN_FILTER_IDE,
		.id = TEST_CAN_EXT_ID_1,
		.mask = CAN_EXT_ID_MASK,
	};

	filter_id = can_add_rx_filter(can_dev, filter_rx_callback, NULL, &filter);
	zassert_true(filter_id >= 0, "Failed to add extended filter");

	can_remove_rx_filter(can_dev, filter_id);
}

/**
 * @brief Test filter with mask
 */
ZTEST(rockchip_can_filtering, test_filter_with_mask)
{
	int filter_id;
	struct can_filter filter = {
		.flags = 0,
		.id = TEST_CAN_STD_ID_1,
		.mask = 0x7E0,  /* Match 0x1C0 to 0x1FF */
	};

	filter_id = can_add_rx_filter(can_dev, filter_rx_callback, NULL, &filter);
	zassert_true(filter_id >= 0, "Failed to add masked filter");

	can_remove_rx_filter(can_dev, filter_id);
}

/**
 * @brief Test filling filter table
 */
ZTEST(rockchip_can_filtering, test_fill_filter_table)
{
	int max_filters;
	int filter_id;
	int filter_ids[16] = {0};
	struct can_filter filter = {
		.flags = 0,
		.id = TEST_CAN_STD_ID_1,
		.mask = CAN_STD_ID_MASK,
	};

	max_filters = can_get_max_filters(can_dev, false);
	zassert_true(max_filters > 0, "Max filters should be > 0");

	/* Try to add up to max_filters */
	for (int i = 0; i < max_filters; i++) {
		filter_id = can_add_rx_filter(can_dev, filter_rx_callback, NULL, &filter);
		if (i == 0) {
        	/* 针对第一个过滤器进行断言，如果失败则直接终止测试并打印错误码 */
        	zassert_true(filter_id >= 0, "Failed to add first filter (err: %d)", filter_id);
    	}	
		if (filter_id >= 0) {
			filter_ids[i] = filter_id;
		}
	}

	/* Clean up */
	for (int i = 0; i < max_filters; i++) {
		if (filter_ids[i] > 0) {
			can_remove_rx_filter(can_dev, filter_ids[i]);
		}
	}
}

/**
 * @brief Test adding filter beyond capacity returns ENOSPC
 */
ZTEST(rockchip_can_filtering, test_add_filter_exceeds_capacity)
{
	int max_filters;
	int filter_id;
	int filter_ids[16] = {0};
	struct can_filter filter = {
		.flags = 0,
		.id = TEST_CAN_STD_ID_1,
		.mask = CAN_STD_ID_MASK,
	};

	max_filters = can_get_max_filters(can_dev, false);

	/* Fill all filters */
	for (int i = 0; i < max_filters; i++) {
		filter_id = can_add_rx_filter(can_dev, filter_rx_callback, NULL, &filter);
		if (filter_id >= 0) {
			filter_ids[i] = filter_id;
		}
	}

	/* Try to add one more beyond capacity */
	filter_id = can_add_rx_filter(can_dev, filter_rx_callback, NULL, &filter);
	zassert_equal(filter_id, -ENOSPC, "Should return ENOSPC when filter table full");

	/* Clean up */
	for (int i = 0; i < max_filters; i++) {
		if (filter_ids[i] >= 0) {
			can_remove_rx_filter(can_dev, filter_ids[i]);
		}
	}
}

/**
 * @brief Test filter with user data
 */
ZTEST(rockchip_can_filtering, test_filter_with_user_data)
{
	int filter_id;
	void *test_user_data = (void *)0xDEADBEEF;
	struct can_filter filter = {
		.flags = 0,
		.id = TEST_CAN_STD_ID_1,
		.mask = CAN_STD_ID_MASK,
	};

	filter_id = can_add_rx_filter(can_dev, filter_rx_callback, test_user_data, &filter);
	zassert_true(filter_id >= 0, "Failed to add filter with user_data");

	can_remove_rx_filter(can_dev, filter_id);
}

/**
 * @brief Test suite setup
 */
static void *rockchip_can_filtering_setup(void)
{
	test_setup();
	filter_rx_count = 0;
	return NULL;
}

/**
 * @brief Test suite teardown
 */
static void rockchip_can_filtering_teardown(void *fixture)
{
	ARG_UNUSED(fixture);
	test_teardown();
}

ZTEST_SUITE(rockchip_can_filtering, NULL, rockchip_can_filtering_setup, NULL,
	    NULL, rockchip_can_filtering_teardown);
```

## src/init_test.c
```c
/*
 * SPDX-License-Identifier: Apache-2.0
 *
 * Rockchip CAN Driver Tests - Initialization Tests
 */

#include <zephyr/drivers/can.h>
#include <zephyr/kernel.h>
#include <zephyr/ztest.h>

#include "common.h"

/**
 * @brief Test that device is ready
 */
ZTEST(rockchip_can_init, test_device_ready)
{
	zassert_true(device_is_ready(can_dev), "CAN device is not ready");
}

/**
 * @brief Test getting CAN capabilities
 */
ZTEST(rockchip_can_init, test_get_capabilities)
{
	can_mode_t capabilities = 0;
	int ret;

	ret = can_get_capabilities(can_dev, &capabilities);
	zassert_equal(ret, 0, "Failed to get capabilities");
	zassert_not_equal(capabilities, 0, "No capabilities reported");

	/* Rockchip should support at least NORMAL mode */
	zassert_true(capabilities & CAN_MODE_NORMAL, "NORMAL mode not supported");

	/* Check for expected optional modes */
	zassert_true(capabilities & CAN_MODE_LOOPBACK, "LOOPBACK mode not supported");
	zassert_true(capabilities & CAN_MODE_LISTENONLY, "LISTENONLY mode not supported");
	zassert_true(capabilities & CAN_MODE_ONE_SHOT, "ONE_SHOT mode not supported");
}

/**
 * @brief Test getting maximum filter count
 */
ZTEST(rockchip_can_init, test_get_max_filters)
{
	int max_filters;

	max_filters = can_get_max_filters(can_dev, false);
	zassert_true(max_filters > 0, "Invalid max_filters value");
	zassert_true(max_filters >= 1, "Must support at least 1 filter");
}

/**
 * @brief Test initial device state (before start)
 */
ZTEST(rockchip_can_init, test_initial_state)
{
	enum can_state state;
	struct can_bus_err_cnt err_cnt;
	int ret;

	ret = can_get_state(can_dev, &state, &err_cnt);
	zassert_equal(ret, 0, "Failed to get device state");
	zassert_equal(state, CAN_STATE_STOPPED, "Initial state should be STOPPED");
}

/**
 * @brief Test setting mode before start
 */
ZTEST(rockchip_can_init, test_set_mode_normal)
{
	int ret;

	ret = can_set_mode(can_dev, CAN_MODE_NORMAL);
	zassert_equal(ret, 0, "Failed to set NORMAL mode");
}

/**
 * @brief Test getting core clock frequency
 */
ZTEST(rockchip_can_init, test_get_core_clock)
{
	uint32_t clock_rate = 0;
	int ret;

	ret = can_get_core_clock(can_dev, &clock_rate);
	zassert_equal(ret, 0, "Failed to get core clock");
	zassert_not_equal(clock_rate, 0, "Core clock frequency should not be zero");
}

/**
 * @brief Test suite setup
 */
static void *rockchip_can_init_setup(void)
{
	test_setup();
	return NULL;
}

/**
 * @brief Test suite teardown
 */
static void rockchip_can_init_teardown(void *fixture)
{
	ARG_UNUSED(fixture);
	test_teardown();
}

ZTEST_SUITE(rockchip_can_init, NULL, rockchip_can_init_setup, NULL,
	    NULL, rockchip_can_init_teardown);
```

## src/interrupt_state_test.c
```c
/*
 * SPDX-License-Identifier: Apache-2.0
 *
 * Rockchip CAN Driver Tests - Interrupt and State Tests
 */

#include <zephyr/drivers/can.h>
#include <zephyr/kernel.h>
#include <zephyr/ztest.h>

#include "common.h"

static enum can_state last_state = CAN_STATE_STOPPED;
static struct can_bus_err_cnt last_err_cnt = {0};

/**
 * @brief State change callback
 */
static void state_change_callback(const struct device *dev, enum can_state state,
				  struct can_bus_err_cnt err_cnt, void *user_data)
{
	zassert_equal(dev, can_dev, "Device mismatch in state callback");
	last_state = state;
	last_err_cnt = err_cnt;
	k_sem_give(&rx_callback_sem);
}

/**
 * @brief Test getting device state
 */
ZTEST(rockchip_can_interrupt_state, test_get_state)
{
	enum can_state state;
	struct can_bus_err_cnt err_cnt;
	int ret;

	ret = can_get_state(can_dev, &state, &err_cnt);
	zassert_equal(ret, 0, "Failed to get state");
	zassert_equal(state, CAN_STATE_STOPPED, "Device should be stopped initially");
	zassert_equal(err_cnt.rx_err_cnt, 0, "Initial RX error count should be 0");
	zassert_equal(err_cnt.tx_err_cnt, 0, "Initial TX error count should be 0");
}

/**
 * @brief Test state after starting
 */
ZTEST(rockchip_can_interrupt_state, test_state_after_start)
{
	enum can_state state;
	struct can_bus_err_cnt err_cnt;
	int ret;

	struct can_timing timing = {
		.sjw = 2,
		.prop_seg = 0,
		.phase_seg1 = 8,
		.phase_seg2 = 4,
		.prescaler = 10,
	};

	can_set_mode(can_dev, CAN_MODE_NORMAL);
	can_set_timing(can_dev, &timing);
	ret = can_start(can_dev);
	zassert_equal(ret, 0, "Failed to start device");

	ret = can_get_state(can_dev, &state, &err_cnt);
	zassert_equal(ret, 0, "Failed to get state");
	zassert_equal(state, CAN_STATE_ERROR_ACTIVE, "Device should be ERROR_ACTIVE when running");

	can_stop(can_dev);
}

/**
 * @brief Test state after stop
 */
ZTEST(rockchip_can_interrupt_state, test_state_after_stop)
{
	enum can_state state;
	int ret;

	struct can_timing timing = {
		.sjw = 2,
		.prop_seg = 0,
		.phase_seg1 = 8,
		.phase_seg2 = 4,
		.prescaler = 10,
	};

	can_set_mode(can_dev, CAN_MODE_NORMAL);
	can_set_timing(can_dev, &timing);
	can_start(can_dev);
	can_stop(can_dev);

	ret = can_get_state(can_dev, &state, NULL);
	zassert_equal(ret, 0, "Failed to get state after stop");
	zassert_equal(state, CAN_STATE_STOPPED, "Device should be STOPPED after stop");
}

/**
 * @brief Test getting error counters
 */
ZTEST(rockchip_can_interrupt_state, test_get_error_counters)
{
	struct can_bus_err_cnt err_cnt;
	int ret;

	ret = can_get_state(can_dev, NULL, &err_cnt);
	zassert_equal(ret, 0, "Failed to get error counters");
	/* Counters should be valid (not negative) */
	zassert_true(err_cnt.rx_err_cnt >= 0, "RX error count should be >= 0");
	zassert_true(err_cnt.tx_err_cnt >= 0, "TX error count should be >= 0");
}

/**
 * @brief Test setting state change callback
 */
ZTEST(rockchip_can_interrupt_state, test_set_state_change_callback)
{
	last_state = CAN_STATE_STOPPED;

	can_set_state_change_callback(can_dev, state_change_callback, NULL);

	/* Callback is now registered, should be called on state changes */
}

/**
 * @brief Test state callback on start
 */
ZTEST(rockchip_can_interrupt_state, test_state_callback_on_start)
{
	int ret;
	struct can_timing timing = {
		.sjw = 2,
		.prop_seg = 0,
		.phase_seg1 = 8,
		.phase_seg2 = 4,
		.prescaler = 10,
	};

	can_set_mode(can_dev, CAN_MODE_NORMAL);
	can_set_timing(can_dev, &timing);
	can_set_state_change_callback(can_dev, state_change_callback, NULL);

	ret = can_start(can_dev);
	zassert_equal(ret, 0, "Failed to start device");

	/* Give some time for callback */
	k_sleep(K_MSEC(10));

	can_stop(can_dev);
}

/**
 * @brief Test removing state change callback
 */
ZTEST(rockchip_can_interrupt_state, test_state_callback_removal)
{
	int ret;
	struct can_timing timing = {
		.sjw = 2,
		.prop_seg = 0,
		.phase_seg1 = 8,
		.phase_seg2 = 4,
		.prescaler = 10,
	};

	can_set_mode(can_dev, CAN_MODE_NORMAL);
	can_set_timing(can_dev, &timing);
	can_set_state_change_callback(can_dev, state_change_callback, NULL);
	ret = can_start(can_dev);
	zassert_equal(ret, 0, "Failed to start device");

	/* Remove callback by setting to NULL */
	can_set_state_change_callback(can_dev, NULL, NULL);

	can_stop(can_dev);
}

/**
 * @brief Test listening only mode state
 */
ZTEST(rockchip_can_interrupt_state, test_listenonly_mode_start)
{
	enum can_state state;
	int ret;

	struct can_timing timing = {
		.sjw = 2,
		.prop_seg = 0,
		.phase_seg1 = 8,
		.phase_seg2 = 4,
		.prescaler = 10,
	};

	can_set_mode(can_dev, CAN_MODE_LISTENONLY);
	can_set_timing(can_dev, &timing);
	ret = can_start(can_dev);
	zassert_equal(ret, 0, "Failed to start in LISTENONLY mode");

	ret = can_get_state(can_dev, &state, NULL);
	zassert_equal(ret, 0, "Failed to get state");
	zassert_not_equal(state, CAN_STATE_STOPPED, "Should not be STOPPED");

	can_stop(can_dev);
}

/**
 * @brief Test loopback mode state
 */
ZTEST(rockchip_can_interrupt_state, test_loopback_mode_start)
{
	enum can_state state;
	int ret;

	struct can_timing timing = {
		.sjw = 2,
		.prop_seg = 0,
		.phase_seg1 = 8,
		.phase_seg2 = 4,
		.prescaler = 10,
	};

	can_set_mode(can_dev, CAN_MODE_LOOPBACK);
	can_set_timing(can_dev, &timing);
	ret = can_start(can_dev);
	zassert_equal(ret, 0, "Failed to start in LOOPBACK mode");

	ret = can_get_state(can_dev, &state, NULL);
	zassert_equal(ret, 0, "Failed to get state");
	zassert_not_equal(state, CAN_STATE_STOPPED, "Should not be STOPPED");

	can_stop(can_dev);
}

/**
 * @brief Test one-shot mode state
 */
ZTEST(rockchip_can_interrupt_state, test_oneshot_mode_start)
{
	enum can_state state;
	int ret;

	struct can_timing timing = {
		.sjw = 2,
		.prop_seg = 0,
		.phase_seg1 = 8,
		.phase_seg2 = 4,
		.prescaler = 10,
	};

	can_set_mode(can_dev, CAN_MODE_ONE_SHOT);
	can_set_timing(can_dev, &timing);
	ret = can_start(can_dev);
	zassert_equal(ret, 0, "Failed to start in ONE_SHOT mode");

	ret = can_get_state(can_dev, &state, NULL);
	zassert_equal(ret, 0, "Failed to get state");
	zassert_not_equal(state, CAN_STATE_STOPPED, "Should not be STOPPED");

	can_stop(can_dev);
}

#ifdef CONFIG_CAN_MANUAL_RECOVERY_MODE
/**
 * @brief Test manual recovery mode
 */
ZTEST(rockchip_can_interrupt_state, test_manual_recovery_mode)
{
	// int ret;

	can_set_mode(can_dev, CAN_MODE_MANUAL_RECOVERY);
	zassert_equal(can_dev, can_dev, "Mode set successfully");

	/* Device should support recovery in this mode */
}

/**
 * @brief Test recovery operation
 */
ZTEST(rockchip_can_interrupt_state, test_recover_device)
{
	int ret;
	struct can_timing timing = {
		.sjw = 2,
		.prop_seg = 0,
		.phase_seg1 = 8,
		.phase_seg2 = 4,
		.prescaler = 10,
	};

	can_set_mode(can_dev, CAN_MODE_MANUAL_RECOVERY);
	can_set_timing(can_dev, &timing);
	can_start(can_dev);

	/* Try recovery with no wait */
	ret = can_recover(can_dev, K_NO_WAIT);
	zassert_true(ret == 0 || ret == -EAGAIN, "Recovery should succeed or timeout");

	can_stop(can_dev);
}
#endif /* CONFIG_CAN_MANUAL_RECOVERY_MODE */

/**
 * @brief Test multiple state transitions
 */
ZTEST(rockchip_can_interrupt_state, test_state_transitions)
{
	enum can_state state1, state2, state3;
	struct can_timing timing = {
		.sjw = 2,
		.prop_seg = 0,
		.phase_seg1 = 8,
		.phase_seg2 = 4,
		.prescaler = 10,
	};

	/* Initial state */
	can_get_state(can_dev, &state1, NULL);
	zassert_equal(state1, CAN_STATE_STOPPED, "Initial state should be STOPPED");

	/* After start */
	can_set_mode(can_dev, CAN_MODE_NORMAL);
	can_set_timing(can_dev, &timing);
	can_start(can_dev);
	can_get_state(can_dev, &state2, NULL);
	zassert_not_equal(state2, CAN_STATE_STOPPED, "State after start should not be STOPPED");

	/* After stop */
	can_stop(can_dev);
	can_get_state(can_dev, &state3, NULL);
	zassert_equal(state3, CAN_STATE_STOPPED, "State after stop should be STOPPED");
}

/**
 * @brief Test suite setup
 */
static void *rockchip_can_interrupt_state_setup(void)
{
	test_setup();
	last_state = CAN_STATE_STOPPED;
	last_err_cnt.rx_err_cnt = 0;
	last_err_cnt.tx_err_cnt = 0;
	return NULL;
}

/**
 * @brief Test suite teardown
 */
static void rockchip_can_interrupt_state_teardown(void *fixture)
{
	ARG_UNUSED(fixture);
	test_teardown();
}

ZTEST_SUITE(rockchip_can_interrupt_state, NULL, rockchip_can_interrupt_state_setup, NULL,
	    NULL, rockchip_can_interrupt_state_teardown);
```

## src/mode_timing_test.c
```c
/*
 * SPDX-License-Identifier: Apache-2.0
 *
 * Rockchip CAN Driver Tests - Mode and Timing Configuration Tests
 */

#include <zephyr/drivers/can.h>
#include <zephyr/kernel.h>
#include <zephyr/ztest.h>

#include "common.h"

/**
 * @brief Test setting CAN_MODE_NORMAL
 */
ZTEST(rockchip_can_mode_timing, test_set_mode_normal)
{
	int ret;

	ret = can_set_mode(can_dev, CAN_MODE_NORMAL);
	zassert_equal(ret, 0, "Failed to set NORMAL mode");
}

/**
 * @brief Test setting CAN_MODE_LOOPBACK
 */
ZTEST(rockchip_can_mode_timing, test_set_mode_loopback)
{
	int ret;

	can_set_mode(can_dev, CAN_MODE_NORMAL);
	ret = can_set_mode(can_dev, CAN_MODE_LOOPBACK);
	zassert_equal(ret, 0, "Failed to set LOOPBACK mode");
}

/**
 * @brief Test setting CAN_MODE_LISTENONLY
 */
ZTEST(rockchip_can_mode_timing, test_set_mode_listenonly)
{
	int ret;

	can_set_mode(can_dev, CAN_MODE_NORMAL);
	ret = can_set_mode(can_dev, CAN_MODE_LISTENONLY);
	zassert_equal(ret, 0, "Failed to set LISTENONLY mode");
}

/**
 * @brief Test setting CAN_MODE_ONE_SHOT
 */
ZTEST(rockchip_can_mode_timing, test_set_mode_one_shot)
{
	int ret;

	can_set_mode(can_dev, CAN_MODE_NORMAL);
	ret = can_set_mode(can_dev, CAN_MODE_ONE_SHOT);
	zassert_equal(ret, 0, "Failed to set ONE_SHOT mode");
}

/**
 * @brief Test setting mode after start returns EBUSY
 */
ZTEST(rockchip_can_mode_timing, test_set_mode_after_start_fails)
{
	int ret;

	can_set_mode(can_dev, CAN_MODE_NORMAL);
	ret = can_start(can_dev);
	zassert_equal(ret, 0, "Failed to start CAN device");

	ret = can_set_mode(can_dev, CAN_MODE_LOOPBACK);
	zassert_equal(ret, -EBUSY, "Should not allow mode change after start");

	can_stop(can_dev);
}

/**
 * @brief Test basic timing configuration
 */
ZTEST(rockchip_can_mode_timing, test_set_timing_valid)
{
	struct can_timing timing = {
		.sjw = 2,
		.prop_seg = 0,
		.phase_seg1 = 8,
		.phase_seg2 = 4,
		.prescaler = 10,
	};
	int ret;

	ret = can_set_timing(can_dev, &timing);
	zassert_equal(ret, 0, "Failed to set valid timing");
}

/**
 * @brief Test timing boundary values - minimum
 */
ZTEST(rockchip_can_mode_timing, test_set_timing_min_values)
{
	struct can_timing timing = {
		.sjw = 1,
		.prop_seg = 0,
		.phase_seg1 = 1,
		.phase_seg2 = 1,
		.prescaler = 1,
	};
	int ret;

	ret = can_set_timing(can_dev, &timing);
	zassert_equal(ret, 0, "Failed to set minimum timing values");
}

/**
 * @brief Test timing boundary values - maximum
 */
ZTEST(rockchip_can_mode_timing, test_set_timing_max_values)
{
	struct can_timing timing = {
		.sjw = 4,
		.prop_seg = 0,
		.phase_seg1 = 16,
		.phase_seg2 = 8,
		.prescaler = 64,
	};
	int ret;

	ret = can_set_timing(can_dev, &timing);
	zassert_equal(ret, 0, "Failed to set maximum timing values");
}

/**
 * @brief Test timing with invalid SJW (too low)
 */
ZTEST(rockchip_can_mode_timing, test_set_timing_sjw_too_low)
{
	struct can_timing timing = {
		.sjw = 0,
		.prop_seg = 0,
		.phase_seg1 = 8,
		.phase_seg2 = 4,
		.prescaler = 10,
	};
	int ret;

	ret = can_set_timing(can_dev, &timing);
	zassert_equal(ret, -EINVAL, "Should reject SJW < 1");
}

/**
 * @brief Test timing with invalid SJW (too high)
 */
ZTEST(rockchip_can_mode_timing, test_set_timing_sjw_too_high)
{
	struct can_timing timing = {
		.sjw = 5,
		.prop_seg = 0,
		.phase_seg1 = 8,
		.phase_seg2 = 4,
		.prescaler = 10,
	};
	int ret;

	ret = can_set_timing(can_dev, &timing);
	zassert_equal(ret, -EINVAL, "Should reject SJW > 4");
}

/**
 * @brief Test timing with invalid prescaler (too low)
 */
ZTEST(rockchip_can_mode_timing, test_set_timing_prescaler_too_low)
{
	struct can_timing timing = {
		.sjw = 2,
		.prop_seg = 0,
		.phase_seg1 = 8,
		.phase_seg2 = 4,
		.prescaler = 0,
	};
	int ret;

	ret = can_set_timing(can_dev, &timing);
	zassert_equal(ret, -EINVAL, "Should reject prescaler < 1");
}

/**
 * @brief Test timing with invalid prescaler (too high)
 */
ZTEST(rockchip_can_mode_timing, test_set_timing_prescaler_too_high)
{
	struct can_timing timing = {
		.sjw = 2,
		.prop_seg = 0,
		.phase_seg1 = 8,
		.phase_seg2 = 4,
		.prescaler = 65,
	};
	int ret;

	ret = can_set_timing(can_dev, &timing);
	zassert_equal(ret, -EINVAL, "Should reject prescaler > 64");
}

/**
 * @brief Test timing with non-zero prop_seg (not allowed)
 */
ZTEST(rockchip_can_mode_timing, test_set_timing_prop_seg_nonzero)
{
	struct can_timing timing = {
		.sjw = 2,
		.prop_seg = 1,  /* Should be 0 for Rockchip */
		.phase_seg1 = 8,
		.phase_seg2 = 4,
		.prescaler = 10,
	};
	int ret;

	ret = can_set_timing(can_dev, &timing);
	zassert_equal(ret, -EINVAL, "Should reject prop_seg != 0");
}

/**
 * @brief Test timing after start returns EBUSY
 */
ZTEST(rockchip_can_mode_timing, test_set_timing_after_start_fails)
{
	struct can_timing timing = {
		.sjw = 2,
		.prop_seg = 0,
		.phase_seg1 = 8,
		.phase_seg2 = 4,
		.prescaler = 10,
	};
	int ret;

	ret = can_start(can_dev);
	zassert_equal(ret, 0, "Failed to start CAN device");

	ret = can_set_timing(can_dev, &timing);
	zassert_equal(ret, -EBUSY, "Should not allow timing change after start");

	can_stop(can_dev);
}

/**
 * @brief Test setting timing with NULL pointer
 */
ZTEST(rockchip_can_mode_timing, test_set_timing_null_pointer)
{
	int ret;

	ret = can_set_timing(can_dev, NULL);
	zassert_equal(ret, -EINVAL, "Should reject NULL timing pointer");
}

/**
 * @brief Test suite setup
 */
static void *rockchip_can_mode_timing_setup(void)
{
	test_setup();
	return NULL;
}

/**
 * @brief Test suite teardown
 */
static void rockchip_can_mode_timing_teardown(void *fixture)
{
	ARG_UNUSED(fixture);
	test_teardown();
}

ZTEST_SUITE(rockchip_can_mode_timing, NULL, rockchip_can_mode_timing_setup, NULL,
	    NULL, rockchip_can_mode_timing_teardown);
```

## src/tx_rx_test.c
```c
/*
 * SPDX-License-Identifier: Apache-2.0
 *
 * Rockchip CAN Driver Tests - Transmission and Reception Tests
 */

#include <zephyr/drivers/can.h>
#include <zephyr/kernel.h>
#include <zephyr/ztest.h>

#include "common.h"

static int tx_callback_count = 0;
static int tx_callback_error = 0;

/**
 * @brief TX callback handler
 */
static void tx_callback(const struct device *dev, int error, void *user_data)
{
	zassert_equal(dev, can_dev, "Device mismatch in TX callback");
	tx_callback_count++;
	tx_callback_error = error;
	k_sem_give(&tx_callback_sem);
}

/**
 * @brief Test basic frame transmission
 */
ZTEST(rockchip_can_tx_rx, test_send_frame)
{
	int ret;

	/* Setup timing and start */
	struct can_timing timing = {
		.sjw = 2,
		.prop_seg = 0,
		.phase_seg1 = 8,
		.phase_seg2 = 4,
		.prescaler = 10,
	};

	can_set_mode(can_dev, CAN_MODE_NORMAL);
	can_set_timing(can_dev, &timing);
	ret = can_start(can_dev);
	zassert_equal(ret, 0, "Failed to start CAN device");

	tx_callback_count = 0;
	ret = can_send(can_dev, &test_std_frame_1, K_NO_WAIT, tx_callback, NULL);
	zassert_equal(ret, 0, "Failed to send frame");

	can_stop(can_dev);
}

/**
 * @brief Test sending without starting returns ENETDOWN
 */
ZTEST(rockchip_can_tx_rx, test_send_without_start)
{
	int ret;

	ret = can_send(can_dev, &test_std_frame_1, K_NO_WAIT, NULL, NULL);
	zassert_equal(ret, -ENETDOWN, "Should fail when device not started");
}

/**
 * @brief Test sending NULL frame returns EINVAL
 */
ZTEST(rockchip_can_tx_rx, test_send_null_frame)
{
	int ret;

	struct can_timing timing = {
		.sjw = 2,
		.prop_seg = 0,
		.phase_seg1 = 8,
		.phase_seg2 = 4,
		.prescaler = 10,
	};

	can_set_mode(can_dev, CAN_MODE_NORMAL);
	can_set_timing(can_dev, &timing);
	can_start(can_dev);

	ret = can_send(can_dev, NULL, K_NO_WAIT, NULL, NULL);
	zassert_equal(ret, -EINVAL, "Should reject NULL frame");

	can_stop(can_dev);
}

/**
 * @brief Test sending standard frame
 */
ZTEST(rockchip_can_tx_rx, test_send_std_frame)
{
	int ret;

	struct can_timing timing = {
		.sjw = 2,
		.prop_seg = 0,
		.phase_seg1 = 8,
		.phase_seg2 = 4,
		.prescaler = 10,
	};

	can_set_mode(can_dev, CAN_MODE_NORMAL);
	can_set_timing(can_dev, &timing);
	ret = can_start(can_dev);
	zassert_equal(ret, 0, "Failed to start device");

	ret = can_send(can_dev, &test_std_frame_1, K_NO_WAIT, NULL, NULL);
	zassert_equal(ret, 0, "Failed to send standard frame");

	can_stop(can_dev);
}

/**
 * @brief Test sending extended frame
 */
ZTEST(rockchip_can_tx_rx, test_send_ext_frame)
{
	int ret;

	struct can_timing timing = {
		.sjw = 2,
		.prop_seg = 0,
		.phase_seg1 = 8,
		.phase_seg2 = 4,
		.prescaler = 10,
	};

	can_set_mode(can_dev, CAN_MODE_NORMAL);
	can_set_timing(can_dev, &timing);
	ret = can_start(can_dev);
	zassert_equal(ret, 0, "Failed to start device");

	ret = can_send(can_dev, &test_ext_frame_1, K_NO_WAIT, NULL, NULL);
	zassert_equal(ret, 0, "Failed to send extended frame");

	can_stop(can_dev);
}

/**
 * @brief Test sending RTR frame
 */
ZTEST(rockchip_can_tx_rx, test_send_rtr_frame)
{
	int ret;

	struct can_timing timing = {
		.sjw = 2,
		.prop_seg = 0,
		.phase_seg1 = 8,
		.phase_seg2 = 4,
		.prescaler = 10,
	};

	can_set_mode(can_dev, CAN_MODE_NORMAL);
	can_set_timing(can_dev, &timing);
	ret = can_start(can_dev);
	zassert_equal(ret, 0, "Failed to start device");

	ret = can_send(can_dev, &test_std_rtr_frame_1, K_NO_WAIT, NULL, NULL);
	zassert_equal(ret, 0, "Failed to send RTR frame");

	can_stop(can_dev);
}

/**
 * @brief Test start/already started
 */
ZTEST(rockchip_can_tx_rx, test_start_already_started)
{
	int ret;

	struct can_timing timing = {
		.sjw = 2,
		.prop_seg = 0,
		.phase_seg1 = 8,
		.phase_seg2 = 4,
		.prescaler = 10,
	};

	can_set_mode(can_dev, CAN_MODE_NORMAL);
	can_set_timing(can_dev, &timing);
	ret = can_start(can_dev);
	zassert_equal(ret, 0, "First start should succeed");

	ret = can_start(can_dev);
	zassert_equal(ret, -EALREADY, "Second start should return EALREADY");

	can_stop(can_dev);
}

/**
 * @brief Test stop/already stopped
 */
ZTEST(rockchip_can_tx_rx, test_stop_already_stopped)
{
	int ret;

	ret = can_stop(can_dev);
	/* Device starts already stopped, so first stop might already return EALREADY */
	zassert_true(ret == 0 || ret == -EALREADY, "Stop should succeed or already stopped");
}

/**
 * @brief Test loopback mode - frame transmission and local receipt
 */
ZTEST(rockchip_can_tx_rx, test_loopback_send_receive)
{
	int ret;
	int filter_id;
	struct can_timing timing = {
		.sjw = 2,
		.prop_seg = 0,
		.phase_seg1 = 8,
		.phase_seg2 = 4,
		.prescaler = 10,
	};
	struct can_filter filter = {
		.flags = 0,
		.id = TEST_CAN_STD_ID_1,
		.mask = CAN_STD_ID_MASK,
	};

	can_set_mode(can_dev, CAN_MODE_LOOPBACK);
	can_set_timing(can_dev, &timing);
	ret = can_start(can_dev);
	zassert_equal(ret, 0, "Failed to start device in loopback");

	/* Add filter for receive */
	filter_id = can_add_rx_filter(can_dev, NULL, NULL, &filter);
	zassert_true(filter_id >= 0, "Failed to add filter");

	/* Send frame */
	ret = can_send(can_dev, &test_std_frame_1, K_NO_WAIT, NULL, NULL);
	zassert_equal(ret, 0, "Failed to send frame");

	can_remove_rx_filter(can_dev, filter_id);
	can_stop(can_dev);
}

/**
 * @brief Test suite setup
 */
static void *rockchip_can_tx_rx_setup(void)
{
	test_setup();
	return NULL;
}

/**
 * @brief Test suite teardown
 */
static void rockchip_can_tx_rx_teardown(void *fixture)
{
	ARG_UNUSED(fixture);
	test_teardown();
}

ZTEST_SUITE(rockchip_can_tx_rx, NULL, rockchip_can_tx_rx_setup, NULL,
	    NULL, rockchip_can_tx_rx_teardown);
```
